## CMakeLists.txt
```
cmake_minimum_required(VERSION 3.20.0)

find_package(Zephyr REQUIRED HINTS $ENV{ZEPHYR_BASE})
project(aitsm_simple)

set(AITSM_GENERATED_DIR ${CMAKE_CURRENT_BINARY_DIR}/generated)
file(MAKE_DIRECTORY ${AITSM_GENERATED_DIR})

# The MQTT credentials come from the build environment. They are written only
# to the ignored build directory and are never stored in the repository.
set(AITSM_MQTT_USERNAME "$ENV{AITSM_MQTT_USERNAME}")
set(AITSM_MQTT_PASSWORD "$ENV{AITSM_MQTT_PASSWORD}")
if(AITSM_MQTT_USERNAME STREQUAL "")
	set(AITSM_MQTT_USERNAME "thingy91x")
endif()

string(REPLACE "\\" "\\\\" AITSM_MQTT_USERNAME "${AITSM_MQTT_USERNAME}")
string(REPLACE "\"" "\\\"" AITSM_MQTT_USERNAME "${AITSM_MQTT_USERNAME}")
string(REPLACE "\\" "\\\\" AITSM_MQTT_PASSWORD "${AITSM_MQTT_PASSWORD}")
string(REPLACE "\"" "\\\"" AITSM_MQTT_PASSWORD "${AITSM_MQTT_PASSWORD}")

configure_file(
	${CMAKE_CURRENT_SOURCE_DIR}/src/mqtt_credentials.h.in
	${AITSM_GENERATED_DIR}/mqtt_credentials.h
	@ONLY
)

# Convert the CA certificate to a byte list that mqtt_client.c includes.
generate_inc_file_for_target(
	app
	${CMAKE_CURRENT_SOURCE_DIR}/certs/ca-cert.pem
	${AITSM_GENERATED_DIR}/ca-cert.pem
)

target_include_directories(app PRIVATE proto ${AITSM_GENERATED_DIR})
target_sources(app PRIVATE
	src/main.c
	src/network.c
	src/mqtt_client.c
	src/sensor.c
	src/batch.c
	src/led.c
	src/sparkplug.c
	proto/sparkplug_b.pb.c
)
```

## Kconfig
```
menu "AITSM Simple"

config AITSM_MEASUREMENT_INTERVAL_SECONDS
	int "Measurement interval in seconds"
	range 5 15
	default 15
	help
	  Fixed interval between measurements. The range follows the project
	  requirement of 5-15 seconds.

config AITSM_BATCH_SIZE
	int "Measurements per NDATA message"
	range 1 28
	default 20
	help
	  A batch is sent when this many measurements are collected. With a
	  15-second interval, 20 measurements give one message every 5 minutes.

config AITSM_BATCH_CAPACITY
	int "Size of the measurement buffer"
	range AITSM_BATCH_SIZE 28
	default 28
	help
	  Number of measurements the device can hold. The extra room above
	  AITSM_BATCH_SIZE keeps new measurements while a batch waits for its
	  PUBACK, or while the connection is down. A full buffer of 28
	  measurements still fits in one message.

config AITSM_LED
	bool "Show the connection status on the RGB LED"
	default y
	help
	  Yellow: searching for the network. Blue: on the network. Green:
	  connected to the broker. White: waiting for PUBACK. Red: startup
	  failed. Disable it when measuring power consumption.

config AITSM_MQTT_HOSTNAME
	string "MQTT broker hostname"
	default "aitsm.vps.webdock.cloud"

config AITSM_SPARKPLUG_GROUP_ID
	string "Sparkplug B group ID"
	default "aitsm"
	help
	  Group ID in the topic spBv1.0/<group_id>/<message_type>/<edge_node_id>.

config AITSM_SPARKPLUG_EDGE_NODE_ID
	string "Sparkplug B edge node ID"
	default "thingy91x"
	help
	  Edge node ID in the topic. Also used as MQTT client ID and as the
	  device ID in the cloud.

endmenu

source "Kconfig.zephyr"
```

## prj.conf
```kconfig
# Logging to the serial console
CONFIG_LOG=y

# Kernel objects used between the threads (k_event; k_msgq and k_sem are always available)
CONFIG_EVENTS=y

# Cellular modem: NB-IoT only on the supplied SIM card
CONFIG_NRF_MODEM_LIB=y
CONFIG_LTE_LINK_CONTROL=y
CONFIG_LTE_NETWORK_MODE_NBIOT=y

# Low power: request PSM so the modem sleeps between the batches. The MQTT
# keepalive is longer than the 5 minutes between batches, so keepalive pings do
# not wake the modem in between.
CONFIG_LTE_LC_PSM_MODULE=y
CONFIG_LTE_PSM_REQ=y
CONFIG_LTE_PSM_REQ_FORMAT_SECONDS=y
CONFIG_LTE_PSM_REQ_RPTAU_SECONDS=3600
CONFIG_LTE_PSM_REQ_RAT_SECONDS=10
CONFIG_MQTT_KEEPALIVE=1200

# Sockets are handled by the modem
CONFIG_NETWORKING=y
CONFIG_NET_NATIVE=n
CONFIG_NET_SOCKETS=y
CONFIG_NET_SOCKETS_OFFLOAD=y

# MQTT over TLS; the CA certificate is stored in the modem under sec tag 42
CONFIG_MQTT_LIB=y
CONFIG_MQTT_LIB_TLS=y
CONFIG_MQTT_HELPER=y
CONFIG_MQTT_HELPER_PORT=8883
CONFIG_MQTT_HELPER_SEC_TAG=42
CONFIG_MODEM_KEY_MGMT=y

# Measurements: modem temperature, battery voltage (nPM1300) and UTC time from the network
CONFIG_MODEM_INFO=y
CONFIG_SENSOR=y
CONFIG_NPM13XX_CHARGER=y
CONFIG_DATE_TIME=y
CONFIG_DATE_TIME_MODEM=y
CONFIG_DATE_TIME_NTP=n

# RGB LED that shows the connection status (PWM); set CONFIG_AITSM_LED=n to keep it off
CONFIG_PWM=y
CONFIG_AITSM_LED=y

# SparkplugB payloads are protobuf, encoded with nanopb
CONFIG_NANOPB=y

# The application thread (main) does the TLS connect and the protobuf encoding
CONFIG_MAIN_STACK_SIZE=4096
CONFIG_HEAP_MEM_POOL_SIZE=2048

# Data profile: measure every 15 s and send 20 measurements together
CONFIG_AITSM_MEASUREMENT_INTERVAL_SECONDS=15
CONFIG_AITSM_BATCH_SIZE=20
CONFIG_AITSM_BATCH_CAPACITY=28
```

## src/main.c
```c
#include <stdlib.h>

#include <zephyr/kernel.h>
#include <zephyr/logging/log.h>
#include <zephyr/sys/util.h>

#include <date_time.h>

#include "batch.h"
#include "led.h"
#include "mqtt_client.h"
#include "network.h"
#include "sensor.h"
#include "sparkplug.h"

LOG_MODULE_REGISTER(main, LOG_LEVEL_INF);

/* Events that wake the application thread. */
#define EVENT_MEASUREMENT BIT(0)
#define EVENT_NETWORK BIT(1)
#define EVENT_MQTT_CONNECTED BIT(2)
#define EVENT_MQTT_DISCONNECTED BIT(3)
#define EVENT_MQTT_PUBACK BIT(4)
#define EVENT_ALL BIT_MASK(5)

#define MEASUREMENT_INTERVAL_MS (CONFIG_AITSM_MEASUREMENT_INTERVAL_SECONDS * MSEC_PER_SEC)
#define MEASUREMENT_QUEUE_LENGTH 8
#define MEASUREMENT_STACK_SIZE 2048
#define MEASUREMENT_PRIORITY 7

#define RECONNECT_INITIAL_SECONDS 5
#define RECONNECT_MAX_SECONDS 60
/* A PUBACK normally arrives within 10 seconds on NB-IoT. */
#define PUBACK_TIMEOUT_SECONDS 120

#define TOPIC_SIZE 64
#define PAYLOAD_SIZE                                                                               \
	MAX(AITSM_SPARKPLUG_NDATA_MAX_SIZE(CONFIG_AITSM_BATCH_CAPACITY),                           \
	    AITSM_SPARKPLUG_NBIRTH_MAX_SIZE)

enum mqtt_state {
	MQTT_IDLE,
	MQTT_CONNECTING,
	MQTT_CONNECTED,
	MQTT_DISCONNECTING,
};

static K_EVENT_DEFINE(app_events);
/* Measurements travel from the measurement thread to the application thread. */
K_MSGQ_DEFINE(measurement_queue, sizeof(struct aitsm_measurement), MEASUREMENT_QUEUE_LENGTH, 8);

/* Everything below is only used by the application thread. */
static enum mqtt_state mqtt_state;
static uint32_t reconnect_delay_seconds = RECONNECT_INITIAL_SECONDS;
static int64_t reconnect_at_ms;
/* A Sparkplug session starts with an acknowledged NBIRTH; bdSeq counts the sessions. */
static bool birth_acknowledged;
static uint8_t bd_seq;
static uint8_t seq;
static bool awaiting_puback;
static int64_t puback_deadline_ms;
/* Number of measurements in the NDATA that waits for its PUBACK. */
static size_t sent_count;
static uint32_t skipped_measurements;
static uint8_t payload[PAYLOAD_SIZE];

/* The callbacks run in the LTE and MQTT threads; they only wake the application thread. */
static void network_handler(void)
{
	k_event_post(&app_events, EVENT_NETWORK);
}

static void mqtt_handler(enum aitsm_mqtt_event event)
{
	switch (event) {
	case AITSM_MQTT_EVENT_CONNECTED:
		k_event_post(&app_events, EVENT_MQTT_CONNECTED);
		break;
	case AITSM_MQTT_EVENT_DISCONNECTED:
		k_event_post(&app_events, EVENT_MQTT_DISCONNECTED);
		break;
	case AITSM_MQTT_EVENT_PUBACK:
		k_event_post(&app_events, EVENT_MQTT_PUBACK);
		break;
	}
}

static void measurement_thread(void *p1, void *p2, void *p3)
{
	int64_t next_ms;

	ARG_UNUSED(p1);
	ARG_UNUSED(p2);
	ARG_UNUSED(p3);

	/* Measurements need a UTC timestamp, which arrives when LTE is connected. */
	aitsm_sensor_wait_for_time();
	next_ms = k_uptime_get();

	while (true) {
		struct aitsm_measurement measurement;

		if (aitsm_sensor_read(&measurement) == 0) {
			if (k_msgq_put(&measurement_queue, &measurement, K_NO_WAIT) == 0) {
				k_event_post(&app_events, EVENT_MEASUREMENT);
			} else {
				LOG_WRN("Målekøen er fuld; måling sprunget over");
			}
		}

		/* Sleep until a fixed point in time, so the time spent reading the
		 * sensor does not shift the interval.
		 */
		next_ms += MEASUREMENT_INTERVAL_MS;
		k_sleep(K_TIMEOUT_ABS_MS(next_ms));
	}
}

K_THREAD_DEFINE(measurement_thread_id, MEASUREMENT_STACK_SIZE, measurement_thread, NULL, NULL, NULL,
		MEASUREMENT_PRIORITY, 0, 0);

/* Move new measurements from the queue into the batch buffer. */
static void collect_measurements(void)
{
	struct aitsm_measurement measurement;

	while (k_msgq_get(&measurement_queue, &measurement, K_NO_WAIT) == 0) {
		if (aitsm_batch_add(&measurement) != 0) {
			skipped_measurements++;
			LOG_WRN("Batchbufferen er fuld; måling sprunget over (%u i alt)",
				skipped_measurements);
			continue;
		}

		LOG_INF("Måling %u/%u: temperatur %d.%02d C, batteri %u.%02u %%",
			(unsigned int)aitsm_batch_count(), CONFIG_AITSM_BATCH_CAPACITY,
			measurement.temperature_centi_celsius / 100,
			abs(measurement.temperature_centi_celsius) % 100,
			measurement.battery_centi_percent / 100U,
			measurement.battery_centi_percent % 100U);
	}
}

static void handle_puback(void)
{
	if (!awaiting_puback) {
		return;
	}
	awaiting_puback = false;

	if (!birth_acknowledged) {
		birth_acknowledged = true;
		/* NBIRTH has seq 0, so the first NDATA of the session has seq 1. */
		seq = 1;
		LOG_INF("NBIRTH bekræftet af brokeren");
		return;
	}

	/* Only now is the batch removed; until the PUBACK it stays in the buffer. */
	aitsm_batch_remove(sent_count);
	seq = aitsm_sparkplug_next_seq(seq);
	LOG_INF("NDATA bekræftet; %u målinger fjernet fra bufferen", (unsigned int)sent_count);
}

/* Wait 5, 10, 20, 40 and then at most 60 seconds between connection attempts. */
static void schedule_reconnect(void)
{
	mqtt_state = MQTT_IDLE;
	reconnect_at_ms = k_uptime_get() + reconnect_delay_seconds * MSEC_PER_SEC;
	LOG_INF("Nyt MQTT-forsøg om %u s", reconnect_delay_seconds);
	reconnect_delay_seconds = MIN(reconnect_delay_seconds * 2U, RECONNECT_MAX_SECONDS);
}

/*
 * A connection can be dead without the modem reporting an error. A missing
 * PUBACK is the sign: close the connection, so the normal reconnect takes over
 * and the batch is sent again.
 */
static void check_puback_timeout(void)
{
	if (!awaiting_puback || k_uptime_get() < puback_deadline_ms) {
		return;
	}

	LOG_WRN("Ingen PUBACK efter %d s; lukker MQTT-forbindelsen", PUBACK_TIMEOUT_SECONDS);
	awaiting_puback = false;
	mqtt_state = MQTT_DISCONNECTING;
	if (aitsm_mqtt_disconnect() != 0) {
		/* Nothing to close, so no callback will come; continue as disconnected. */
		k_event_post(&app_events, EVENT_MQTT_DISCONNECTED);
	}
}

static void update_connection(uint32_t events)
{
	if ((events & EVENT_MQTT_CONNECTED) != 0U && mqtt_state == MQTT_CONNECTING) {
		mqtt_state = MQTT_CONNECTED;
		reconnect_delay_seconds = RECONNECT_INITIAL_SECONDS;
	}

	if ((events & EVENT_MQTT_DISCONNECTED) != 0U && mqtt_state != MQTT_IDLE) {
		/* Unacknowledged measurements stay in the batch and are sent again. */
		awaiting_puback = false;
		birth_acknowledged = false;
		bd_seq = aitsm_sparkplug_next_seq(bd_seq);
		schedule_reconnect();
	}

	if (mqtt_state == MQTT_IDLE && aitsm_network_is_connected() &&
	    k_uptime_get() >= reconnect_at_ms) {
		LOG_INF("Forbinder til MQTT-brokeren");
		if (aitsm_mqtt_connect() == 0) {
			mqtt_state = MQTT_CONNECTING;
		} else {
			schedule_reconnect();
		}
	}
}

static int publish(enum aitsm_sparkplug_message_type type, size_t length)
{
	char topic[TOPIC_SIZE];
	int err = aitsm_sparkplug_topic(topic, sizeof(topic), type);

	if (err == 0) {
		err = aitsm_mqtt_publish(topic, payload, length);
	}
	if (err == 0) {
		awaiting_puback = true;
		puback_deadline_ms = k_uptime_get() + PUBACK_TIMEOUT_SECONDS * MSEC_PER_SEC;
	}
	return err;
}

/* Send NBIRTH first in a new session, and afterwards NDATA when a batch is ready. */
static void publish_next(void)
{
	size_t length;
	int err;

	if (mqtt_state != MQTT_CONNECTED || awaiting_puback) {
		return;
	}

	if (!birth_acknowledged) {
		int64_t now_ms = 0;

		(void)date_time_now(&now_ms);
		err = aitsm_sparkplug_encode_nbirth(payload, sizeof(payload), &length,
						    (uint64_t)now_ms, bd_seq);
		if (err == 0) {
			err = publish(AITSM_SPARKPLUG_NBIRTH, length);
		}
		if (err == 0) {
			LOG_INF("NBIRTH sendt (bdSeq %u); venter på PUBACK", bd_seq);
		}
	} else if (aitsm_batch_is_ready()) {
		sent_count = aitsm_batch_count();
		err = aitsm_sparkplug_encode_ndata(payload, sizeof(payload), &length,
						   aitsm_batch_data(), sent_count, seq);
		if (err == 0) {
			err = publish(AITSM_SPARKPLUG_NDATA, length);
		}
		if (err == 0) {
			LOG_INF("NDATA sendt: %u målinger, %u bytes, seq %u; venter på PUBACK",
				(unsigned int)sent_count, (unsigned int)length, seq);
		}
	} else {
		return;
	}

	if (err != 0) {
		/* The data stays in the buffer and is tried again at the next wake-up. */
		LOG_WRN("Afsendelse fejlede: %d", err);
	}
}

/* The LED shows how far the device is: network, broker and sending. */
static void update_led(void)
{
	if (awaiting_puback) {
		/* White: a message is sent and waits for its PUBACK. */
		aitsm_led_set(AITSM_LED_WHITE);
	} else if (mqtt_state == MQTT_CONNECTED) {
		/* Green: connected to the broker. */
		aitsm_led_set(AITSM_LED_GREEN);
	} else if (aitsm_network_is_connected()) {
		/* Blue: on the NB-IoT network, but not connected to the broker. */
		aitsm_led_set(AITSM_LED_BLUE);
	} else {
		/* Yellow: searching for the network. */
		aitsm_led_set(AITSM_LED_YELLOW);
	}
}

/* Sleep until an event arrives, a PUBACK is overdue or the next connection attempt is due. */
static k_timeout_t next_wakeup(void)
{
	if (awaiting_puback) {
		return K_TIMEOUT_ABS_MS(puback_deadline_ms);
	}
	if (mqtt_state == MQTT_IDLE && aitsm_network_is_connected()) {
		return K_TIMEOUT_ABS_MS(reconnect_at_ms);
	}
	return K_FOREVER;
}

int main(void)
{
	int err;

	LOG_INF("AITSM Simple starter");

	err = aitsm_led_init();
	if (err == 0) {
		err = aitsm_network_init(network_handler);
	}
	if (err == 0) {
		err = aitsm_sensor_init();
	}
	if (err == 0) {
		err = aitsm_mqtt_init(mqtt_handler);
	}
	if (err == 0) {
		err = aitsm_network_connect();
	}
	if (err != 0) {
		LOG_ERR("Opstart fejlede: %d", err);
		/* Red: the device could not start. */
		aitsm_led_set(AITSM_LED_RED);
		return err;
	}

	/* The main thread continues as the application thread. */
	while (true) {
		uint32_t events;

		update_led();
		events = k_event_wait_safe(&app_events, EVENT_ALL, false, next_wakeup());

		collect_measurements();
		if ((events & EVENT_MQTT_PUBACK) != 0U) {
			handle_puback();
		}
		check_puback_timeout();
		update_connection(events);
		publish_next();
	}

	return 0;
}
```

## src/batch.c
```c
#include <errno.h>
#include <string.h>

#include <zephyr/sys/util.h>

#include "batch.h"

BUILD_ASSERT(CONFIG_AITSM_BATCH_SIZE <= CONFIG_AITSM_BATCH_CAPACITY,
	     "CONFIG_AITSM_BATCH_SIZE must fit in CONFIG_AITSM_BATCH_CAPACITY");

static struct aitsm_measurement buffer[CONFIG_AITSM_BATCH_CAPACITY];
static size_t count;

void aitsm_batch_reset(void)
{
	count = 0;
}

int aitsm_batch_add(const struct aitsm_measurement *measurement)
{
	if (count >= ARRAY_SIZE(buffer)) {
		return -ENOSPC;
	}

	buffer[count++] = *measurement;
	return 0;
}

size_t aitsm_batch_count(void)
{
	return count;
}

bool aitsm_batch_is_ready(void)
{
	return count >= CONFIG_AITSM_BATCH_SIZE;
}

const struct aitsm_measurement *aitsm_batch_data(void)
{
	return buffer;
}

void aitsm_batch_remove(size_t removed)
{
	removed = MIN(removed, count);

	/* Measurements added while waiting for the acknowledgement move to the front. */
	memmove(buffer, &buffer[removed], (count - removed) * sizeof(buffer[0]));
	count -= removed;
}
```

## src/batch.h
```c
#ifndef AITSM_BATCH_H_
#define AITSM_BATCH_H_

#include <stdbool.h>
#include <stddef.h>

#include "sensor.h"

/*
 * Fixed buffer of measurements that are sent together in one message.
 * The buffer has no locking: it is only used from the application thread.
 */

/** Empty the buffer. */
void aitsm_batch_reset(void);

/** Add a measurement. Returns -ENOSPC when the buffer is full; nothing is overwritten. */
int aitsm_batch_add(const struct aitsm_measurement *measurement);

/** Number of measurements in the buffer. */
size_t aitsm_batch_count(void);

/** True when the buffer holds CONFIG_AITSM_BATCH_SIZE measurements or more. */
bool aitsm_batch_is_ready(void);

/** The buffered measurements, oldest first. */
const struct aitsm_measurement *aitsm_batch_data(void);

/** Remove the count oldest measurements after the broker has acknowledged them. */
void aitsm_batch_remove(size_t count);

#endif /* AITSM_BATCH_H_ */
```

## src/led.c
```c
#include <errno.h>
#include <stdbool.h>

#include <zephyr/devicetree.h>
#include <zephyr/drivers/pwm.h>
#include <zephyr/logging/log.h>
#include <zephyr/sys/util.h>

#include "led.h"

LOG_MODULE_REGISTER(led, LOG_LEVEL_INF);

/* The LED is dimmed to 1/8 of full brightness to save power. */
#define BRIGHTNESS_DIVIDER 8

static const struct pwm_dt_spec red_led = PWM_DT_SPEC_GET(DT_ALIAS(pwm_led0));
static const struct pwm_dt_spec green_led = PWM_DT_SPEC_GET(DT_ALIAS(pwm_led1));
static const struct pwm_dt_spec blue_led = PWM_DT_SPEC_GET(DT_ALIAS(pwm_led2));

static void set_channel(const struct pwm_dt_spec *led, bool on)
{
	(void)pwm_set_pulse_dt(led, on ? led->period / BRIGHTNESS_DIVIDER : 0);
}

int aitsm_led_init(void)
{
	if (!pwm_is_ready_dt(&red_led) || !pwm_is_ready_dt(&green_led) ||
	    !pwm_is_ready_dt(&blue_led)) {
		LOG_ERR("RGB-LED'en er ikke klar");
		return -ENODEV;
	}

	aitsm_led_set(AITSM_LED_OFF);
	return 0;
}

void aitsm_led_set(enum aitsm_led_color color)
{
	if (!IS_ENABLED(CONFIG_AITSM_LED)) {
		color = AITSM_LED_OFF;
	}

	/* Yellow is red and green together; white is all three. */
	set_channel(&red_led, color == AITSM_LED_RED || color == AITSM_LED_YELLOW ||
				      color == AITSM_LED_WHITE);
	set_channel(&green_led, color == AITSM_LED_GREEN || color == AITSM_LED_YELLOW ||
					color == AITSM_LED_WHITE);
	set_channel(&blue_led, color == AITSM_LED_BLUE || color == AITSM_LED_WHITE);
}
```

## src/led.h
```c
#ifndef AITSM_LED_H_
#define AITSM_LED_H_

/** Colours shown on the RGB LED. Each colour has one meaning; see main.c. */
enum aitsm_led_color {
	AITSM_LED_OFF,
	AITSM_LED_RED,
	AITSM_LED_YELLOW,
	AITSM_LED_GREEN,
	AITSM_LED_BLUE,
	AITSM_LED_WHITE,
};

/** Check that the three PWM channels of the RGB LED are ready. */
int aitsm_led_init(void);

/** Show a colour until the next call. Does nothing when CONFIG_AITSM_LED=n. */
void aitsm_led_set(enum aitsm_led_color color);

#endif /* AITSM_LED_H_ */
```

## src/mqtt_client.c
```c
#include <errno.h>
#include <string.h>

#include <zephyr/kernel.h>
#include <zephyr/logging/log.h>
#include <zephyr/net/mqtt.h>
#include <zephyr/sys/atomic.h>

#include <modem/modem_key_mgmt.h>
#include <net/mqtt_helper.h>

#include "mqtt_client.h"
/* Generated at build time from AITSM_MQTT_USERNAME and AITSM_MQTT_PASSWORD. */
#include "mqtt_credentials.h"

LOG_MODULE_REGISTER(mqtt_client, LOG_LEVEL_INF);

/* CA certificate used by the modem to verify the broker's TLS certificate. */
static const unsigned char ca_certificate[] = {
#include "ca-cert.pem"
};

static char hostname[] = CONFIG_AITSM_MQTT_HOSTNAME;
static char client_id[] = CONFIG_AITSM_SPARKPLUG_EDGE_NODE_ID;
static char username[] = AITSM_MQTT_USERNAME;
static char password[] = AITSM_MQTT_PASSWORD;

static aitsm_mqtt_handler_t mqtt_handler;
/* Message id of the publish that waits for its PUBACK; 0 when none is waiting. */
static atomic_t pending_message_id;

static void on_connack(enum mqtt_conn_return_code return_code, bool session_present)
{
	ARG_UNUSED(session_present);

	if (return_code != MQTT_CONNECTION_ACCEPTED) {
		/* mqtt_helper closes the socket and calls on_disconnect afterwards. */
		LOG_ERR("Brokeren afviste forbindelsen, kode: %d", return_code);
		return;
	}

	LOG_INF("Forbundet til %s over TLS", hostname);
	mqtt_handler(AITSM_MQTT_EVENT_CONNECTED);
}

static void on_disconnect(int result)
{
	LOG_WRN("MQTT-forbindelsen er lukket, resultat: %d", result);
	atomic_clear(&pending_message_id);
	mqtt_handler(AITSM_MQTT_EVENT_DISCONNECTED);
}

static void on_puback(uint16_t message_id, int result)
{
	if (result != 0 || !atomic_cas(&pending_message_id, message_id, 0)) {
		LOG_WRN("Uventet PUBACK, message id: %u, resultat: %d", message_id, result);
		return;
	}

	mqtt_handler(AITSM_MQTT_EVENT_PUBACK);
}

static int provision_ca_certificate(void)
{
	/* The modem stores the certificate under the sec tag that the TLS socket uses. */
	int err = modem_key_mgmt_write(CONFIG_MQTT_HELPER_SEC_TAG,
				       MODEM_KEY_MGMT_CRED_TYPE_CA_CHAIN, ca_certificate,
				       sizeof(ca_certificate));

	if (err != 0) {
		LOG_ERR("CA-certifikatet kunne ikke gemmes i modemmet: %d", err);
	}
	return err;
}

int aitsm_mqtt_init(aitsm_mqtt_handler_t handler)
{
	struct mqtt_helper_cfg config = {
		.cb = {
			.on_connack = on_connack,
			.on_disconnect = on_disconnect,
			.on_puback = on_puback,
		},
	};
	int err;

	if (strlen(AITSM_MQTT_PASSWORD) == 0) {
		LOG_ERR("MQTT-password mangler; angiv AITSM_MQTT_PASSWORD ved build");
		return -EINVAL;
	}

	mqtt_handler = handler;

	err = provision_ca_certificate();
	if (err != 0) {
		return err;
	}

	err = mqtt_helper_init(&config);
	if (err != 0) {
		LOG_ERR("MQTT-klienten kunne ikke initialiseres: %d", err);
	}
	return err;
}

int aitsm_mqtt_connect(void)
{
	struct mqtt_helper_conn_params params = {
		.hostname = { .ptr = hostname, .size = sizeof(hostname) - 1 },
		.device_id = { .ptr = client_id, .size = sizeof(client_id) - 1 },
		.user_name = { .ptr = username, .size = sizeof(username) - 1 },
		.password = { .ptr = password, .size = sizeof(password) - 1 },
	};
	int err = mqtt_helper_connect(&params);

	if (err != 0) {
		LOG_ERR("Kunne ikke forbinde til %s: %d", hostname, err);
	}
	return err;
}

int aitsm_mqtt_disconnect(void)
{
	return mqtt_helper_disconnect();
}

int aitsm_mqtt_publish(const char *topic, const uint8_t *payload, size_t length)
{
	struct mqtt_publish_param param = {
		.message = {
			.topic = {
				.topic = { .utf8 = topic, .size = strlen(topic) },
				.qos = MQTT_QOS_1_AT_LEAST_ONCE,
			},
			.payload = { .data = (uint8_t *)payload, .len = length },
		},
		.message_id = mqtt_helper_msg_id_get(),
	};
	int err;

	/* Set before sending: the PUBACK can arrive before mqtt_helper_publish returns. */
	if (!atomic_cas(&pending_message_id, 0, param.message_id)) {
		return -EBUSY;
	}

	err = mqtt_helper_publish(&param);
	if (err != 0) {
		atomic_clear(&pending_message_id);
		LOG_WRN("MQTT-publish fejlede: %d", err);
	}
	return err;
}
```

## src/mqtt_client.h
```c
#ifndef AITSM_MQTT_CLIENT_H_
#define AITSM_MQTT_CLIENT_H_

#include <stddef.h>
#include <stdint.h>

/** Reported from the MQTT callbacks to the application. */
enum aitsm_mqtt_event {
	/** The broker accepted the connection. */
	AITSM_MQTT_EVENT_CONNECTED,
	/** The connection was closed or could not be established. */
	AITSM_MQTT_EVENT_DISCONNECTED,
	/** The broker acknowledged (PUBACK) the last published message. */
	AITSM_MQTT_EVENT_PUBACK,
};

typedef void (*aitsm_mqtt_handler_t)(enum aitsm_mqtt_event event);

/**
 * Store the CA certificate in the modem and initialize the MQTT client.
 * Must be called after the modem is initialized and before LTE is connected,
 * because the modem only accepts certificates while it is offline.
 */
int aitsm_mqtt_init(aitsm_mqtt_handler_t handler);

/**
 * Connect to the broker over TLS. Blocks during DNS lookup and TLS handshake.
 * Returns 0 when the request is sent; the result is then reported to the
 * handler as CONNECTED or DISCONNECTED.
 */
int aitsm_mqtt_connect(void);

/**
 * Close the connection. The result is reported to the handler as DISCONNECTED
 * when 0 is returned; otherwise there was no connection to close.
 */
int aitsm_mqtt_disconnect(void);

/**
 * Publish a message with QoS 1. Only one message can wait for its PUBACK at a
 * time; the acknowledgement is reported to the handler as PUBACK.
 */
int aitsm_mqtt_publish(const char *topic, const uint8_t *payload, size_t length);

#endif /* AITSM_MQTT_CLIENT_H_ */
```

## src/network.c
```c
#include <zephyr/logging/log.h>
#include <zephyr/sys/atomic.h>

#include <modem/lte_lc.h>
#include <modem/nrf_modem_lib.h>

#include "network.h"

LOG_MODULE_REGISTER(network, LOG_LEVEL_INF);

static aitsm_network_handler_t network_handler;
/* Written by the LTE callback and read by the application thread. */
static atomic_t registered;

static void lte_event_handler(const struct lte_lc_evt *const event)
{
	switch (event->type) {
	case LTE_LC_EVT_NW_REG_STATUS:
		switch (event->nw_reg_status) {
		case LTE_LC_NW_REG_REGISTERED_HOME:
		case LTE_LC_NW_REG_REGISTERED_ROAMING:
			LOG_INF("Registreret på NB-IoT-netværket");
			atomic_set(&registered, 1);
			break;
		case LTE_LC_NW_REG_SEARCHING:
			LOG_INF("Søger efter netværk");
			atomic_set(&registered, 0);
			break;
		default:
			LOG_WRN("Ikke registreret på netværket, status: %d", event->nw_reg_status);
			atomic_set(&registered, 0);
			break;
		}
		network_handler();
		break;
	case LTE_LC_EVT_PSM_UPDATE:
		/* The network decides the values; active_time is -1 when PSM is refused. */
		LOG_INF("PSM tildelt: TAU %d s, aktiv tid %d s", event->psm_cfg.tau,
			event->psm_cfg.active_time);
		break;
	default:
		break;
	}
}

int aitsm_network_init(aitsm_network_handler_t handler)
{
	int err;

	network_handler = handler;

	err = nrf_modem_lib_init();
	if (err != 0) {
		LOG_ERR("Modemmet kunne ikke initialiseres: %d", err);
	}
	return err;
}

int aitsm_network_connect(void)
{
	int err;

	/* Register before connecting so the first network event is not missed. */
	lte_lc_register_handler(lte_event_handler);

	LOG_INF("Forbinder til NB-IoT-netværket; det kan tage et par minutter");
	err = lte_lc_connect_async(NULL);
	if (err != 0) {
		LOG_ERR("LTE-forbindelsen kunne ikke startes: %d", err);
	}
	return err;
}

bool aitsm_network_is_connected(void)
{
	return atomic_get(&registered) != 0;
}
```

## src/network.h
```c
#ifndef AITSM_NETWORK_H_
#define AITSM_NETWORK_H_

#include <stdbool.h>

/** Called from the LTE callback when the device joins or leaves the network. */
typedef void (*aitsm_network_handler_t)(void);

/** Initialize the nRF modem. Must be called before the other modules use the modem. */
int aitsm_network_init(aitsm_network_handler_t handler);

/** Start connecting to the NB-IoT network; the result is reported to the handler. */
int aitsm_network_connect(void);

/** True while the device is registered on the network. */
bool aitsm_network_is_connected(void);

#endif /* AITSM_NETWORK_H_ */
```

## src/sensor.c
```c
#include <errno.h>

#include <zephyr/device.h>
#include <zephyr/devicetree.h>
#include <zephyr/drivers/sensor.h>
#include <zephyr/kernel.h>
#include <zephyr/logging/log.h>

#include <date_time.h>
#include <modem/modem_info.h>

#include "sensor.h"

LOG_MODULE_REGISTER(sensor, LOG_LEVEL_INF);

#define BATTERY_EMPTY_MV 3200
#define BATTERY_FULL_MV 4200

static const struct device *const battery_device = DEVICE_DT_GET(DT_NODELABEL(npm1300_charger));

/* Given once the date_time library has UTC time from the modem. */
static K_SEM_DEFINE(time_ready, 0, 1);

static void date_time_handler(const struct date_time_evt *event)
{
	if (event->type != DATE_TIME_NOT_OBTAINED) {
		k_sem_give(&time_ready);
	}
}

static uint16_t battery_percent_from_voltage(int64_t voltage_mv)
{
	if (voltage_mv <= BATTERY_EMPTY_MV) {
		return 0;
	}
	if (voltage_mv >= BATTERY_FULL_MV) {
		return 10000;
	}

	return (uint16_t)(((voltage_mv - BATTERY_EMPTY_MV) * 10000) /
			  (BATTERY_FULL_MV - BATTERY_EMPTY_MV));
}

int aitsm_sensor_init(void)
{
	if (!device_is_ready(battery_device)) {
		LOG_ERR("nPM1300-batterimåleren er ikke klar");
		return -ENODEV;
	}

	date_time_register_handler(date_time_handler);
	return 0;
}

void aitsm_sensor_wait_for_time(void)
{
	(void)k_sem_take(&time_ready, K_FOREVER);
	LOG_INF("UTC-tid modtaget fra netværket");
}

int aitsm_sensor_read(struct aitsm_measurement *measurement)
{
	struct sensor_value battery_voltage;
	int64_t timestamp_ms;
	int temperature_celsius;
	int err;

	err = date_time_now(&timestamp_ms);
	if (err != 0) {
		LOG_WRN("UTC-tid er ikke gyldig: %d", err);
		return err;
	}

	err = modem_info_get_temperature(&temperature_celsius);
	if (err != 0) {
		LOG_WRN("Kunne ikke læse modemtemperatur: %d", err);
		return err;
	}

	err = sensor_sample_fetch(battery_device);
	if (err == 0) {
		err = sensor_channel_get(battery_device, SENSOR_CHAN_GAUGE_VOLTAGE,
					 &battery_voltage);
	}
	if (err != 0) {
		LOG_WRN("Kunne ikke læse batterispænding: %d", err);
		return err;
	}

	measurement->timestamp = timestamp_ms / 1000;
	measurement->temperature_centi_celsius = temperature_celsius * 100;
	measurement->battery_centi_percent =
		battery_percent_from_voltage(sensor_value_to_milli(&battery_voltage));
	return 0;
}
```

## src/sensor.h
```c
#ifndef AITSM_SENSOR_H_
#define AITSM_SENSOR_H_

#include <stdint.h>

/** One measurement with the time it was taken. */
struct aitsm_measurement {
	/** UTC time in seconds since 1970. */
	int64_t timestamp;
	/** Temperature in hundredths of a degree Celsius. */
	int32_t temperature_centi_celsius;
	/** Battery level in hundredths of a percent. */
	uint16_t battery_centi_percent;
};

/** Check the battery sensor and start listening for UTC time from the network. */
int aitsm_sensor_init(void);

/** Block until the device has received UTC time from the network. */
void aitsm_sensor_wait_for_time(void);

/** Read modem temperature, battery level and UTC time. */
int aitsm_sensor_read(struct aitsm_measurement *measurement);

#endif /* AITSM_SENSOR_H_ */
```

## src/sparkplug.c
```c
#include <errno.h>
#include <stdio.h>
#include <string.h>

#include <zephyr/sys/util.h>

#include <pb_encode.h>

#include "sparkplug.h"
#include "sparkplug_b.pb.h"

/* Sparkplug B DataType enumeration values used here. */
#define SPARKPLUG_DATATYPE_INT64 4U
#define SPARKPLUG_DATATYPE_FLOAT 9U

static const char *const message_type_names[] = {
	[AITSM_SPARKPLUG_NBIRTH] = "NBIRTH",
	[AITSM_SPARKPLUG_NDATA] = "NDATA",
};

struct metrics_context {
	enum aitsm_sparkplug_message_type type;
	const struct aitsm_measurement *measurements;
	size_t count;
	uint8_t bd_seq;
};

static bool encode_metric(pb_ostream_t *stream,
			  const org_eclipse_tahu_protobuf_Payload_Metric *metric)
{
	return pb_encode_tag(stream, PB_WT_STRING,
			     org_eclipse_tahu_protobuf_Payload_metrics_tag) &&
	       pb_encode_submessage(stream, org_eclipse_tahu_protobuf_Payload_Metric_fields,
				    metric);
}

static bool encode_bdseq_metric(pb_ostream_t *stream, uint8_t bd_seq)
{
	org_eclipse_tahu_protobuf_Payload_Metric metric =
		org_eclipse_tahu_protobuf_Payload_Metric_init_zero;

	metric.has_name = true;
	strcpy(metric.name, AITSM_SPARKPLUG_METRIC_BDSEQ);
	metric.has_datatype = true;
	metric.datatype = SPARKPLUG_DATATYPE_INT64;
	metric.which_value = org_eclipse_tahu_protobuf_Payload_Metric_long_value_tag;
	metric.value.long_value = bd_seq;
	return encode_metric(stream, &metric);
}

static bool encode_float_metric(pb_ostream_t *stream, const char *name, float value,
				uint64_t timestamp_ms, bool historical, bool is_null)
{
	org_eclipse_tahu_protobuf_Payload_Metric metric =
		org_eclipse_tahu_protobuf_Payload_Metric_init_zero;

	metric.has_name = true;
	strncpy(metric.name, name, sizeof(metric.name) - 1);
	metric.has_datatype = true;
	metric.datatype = SPARKPLUG_DATATYPE_FLOAT;
	if (!is_null) {
		metric.has_timestamp = true;
		metric.timestamp = timestamp_ms;
		metric.which_value = org_eclipse_tahu_protobuf_Payload_Metric_float_value_tag;
		metric.value.float_value = value;
	} else {
		metric.has_is_null = true;
		metric.is_null = true;
	}
	if (historical) {
		metric.has_is_historical = true;
		metric.is_historical = true;
	}
	return encode_metric(stream, &metric);
}

static bool encode_metrics(pb_ostream_t *stream, const pb_field_t *field, void *const *arg)
{
	const struct metrics_context *context = *arg;

	(void)field;
	if (context->type == AITSM_SPARKPLUG_NBIRTH) {
		if (!encode_bdseq_metric(stream, context->bd_seq)) {
			return false;
		}
		/* NBIRTH declares the metrics that NDATA carries, without values. */
		return encode_float_metric(stream, AITSM_SPARKPLUG_METRIC_TEMPERATURE, 0.0f, 0,
					   false, true) &&
		       encode_float_metric(stream, AITSM_SPARKPLUG_METRIC_BATTERY, 0.0f, 0,
					   false, true);
	}

	for (size_t i = 0; i < context->count; i++) {
		const struct aitsm_measurement *measurement = &context->measurements[i];
		uint64_t timestamp_ms = (uint64_t)measurement->timestamp * 1000U;

		if (!encode_float_metric(stream, AITSM_SPARKPLUG_METRIC_TEMPERATURE,
					 (float)measurement->temperature_centi_celsius / 100.0f,
					 timestamp_ms, true, false) ||
		    !encode_float_metric(stream, AITSM_SPARKPLUG_METRIC_BATTERY,
					 (float)measurement->battery_centi_percent / 100.0f,
					 timestamp_ms, true, false)) {
			return false;
		}
	}
	return true;
}

static int encode_payload(uint8_t *buffer, size_t capacity, size_t *length,
			  const struct metrics_context *context, uint64_t timestamp_ms,
			  bool has_seq, uint8_t seq)
{
	org_eclipse_tahu_protobuf_Payload payload = org_eclipse_tahu_protobuf_Payload_init_zero;
	pb_ostream_t stream;

	if (buffer == NULL || length == NULL) {
		return -EINVAL;
	}

	payload.metrics.funcs.encode = encode_metrics;
	payload.metrics.arg = (void *)context;
	if (timestamp_ms != 0) {
		payload.has_timestamp = true;
		payload.timestamp = timestamp_ms;
	}
	if (has_seq) {
		payload.has_seq = true;
		payload.seq = seq;
	}

	stream = pb_ostream_from_buffer(buffer, capacity);
	if (!pb_encode(&stream, org_eclipse_tahu_protobuf_Payload_fields, &payload)) {
		return -EMSGSIZE;
	}

	*length = stream.bytes_written;
	return 0;
}

int aitsm_sparkplug_topic(char *buffer, size_t capacity,
			  enum aitsm_sparkplug_message_type type)
{
	int written;

	if (buffer == NULL || (size_t)type >= ARRAY_SIZE(message_type_names)) {
		return -EINVAL;
	}

	written = snprintf(buffer, capacity, "spBv1.0/%s/%s/%s",
			   CONFIG_AITSM_SPARKPLUG_GROUP_ID, message_type_names[type],
			   CONFIG_AITSM_SPARKPLUG_EDGE_NODE_ID);
	if (written < 0 || (size_t)written >= capacity) {
		return -EMSGSIZE;
	}

	return 0;
}

uint8_t aitsm_sparkplug_next_seq(uint8_t seq)
{
	return (uint8_t)((seq + 1U) % AITSM_SPARKPLUG_SEQ_MODULO);
}

int aitsm_sparkplug_encode_nbirth(uint8_t *buffer, size_t capacity, size_t *length,
				  uint64_t timestamp_ms, uint8_t bd_seq)
{
	const struct metrics_context context = {
		.type = AITSM_SPARKPLUG_NBIRTH,
		.bd_seq = bd_seq,
	};

	return encode_payload(buffer, capacity, length, &context, timestamp_ms, true, 0);
}

int aitsm_sparkplug_encode_ndata(uint8_t *buffer, size_t capacity, size_t *length,
				 const struct aitsm_measurement *measurements, size_t count,
				 uint8_t seq)
{
	const struct metrics_context context = {
		.type = AITSM_SPARKPLUG_NDATA,
		.measurements = measurements,
		.count = count,
	};

	if (measurements == NULL || count == 0) {
		return -EINVAL;
	}

	return encode_payload(buffer, capacity, length, &context,
			      (uint64_t)measurements[count - 1U].timestamp * 1000U, true, seq);
}
```

## src/sparkplug.h
```c
#ifndef AITSM_SPARKPLUG_H_
#define AITSM_SPARKPLUG_H_

#include <stddef.h>
#include <stdint.h>

#include "sensor.h"

/** Sparkplug B v1.0 message types used by the edge node. */
enum aitsm_sparkplug_message_type {
	AITSM_SPARKPLUG_NBIRTH,
	AITSM_SPARKPLUG_NDATA,
};

/** Sequence numbers wrap from 255 to 0 (Sparkplug B v1.0, section 6.4.19). */
#define AITSM_SPARKPLUG_SEQ_MODULO 256U

/** Metric names shared by NBIRTH and NDATA. */
#define AITSM_SPARKPLUG_METRIC_TEMPERATURE "temperature"
#define AITSM_SPARKPLUG_METRIC_BATTERY "battery"
#define AITSM_SPARKPLUG_METRIC_BDSEQ "bdSeq"

/**
 * Upper bound for an NDATA payload with count measurements: payload header
 * (timestamp and seq) plus two metrics per measurement, each with name,
 * timestamp, datatype, historical flag and a float value.
 */
#define AITSM_SPARKPLUG_NDATA_MAX_SIZE(count) (16U + (count) * 70U)

/** An NBIRTH payload always fits in this many bytes. */
#define AITSM_SPARKPLUG_NBIRTH_MAX_SIZE 80U

/**
 * Write the topic spBv1.0/<group_id>/<message type>/<edge_node_id>.
 * Returns -EMSGSIZE if it does not fit, including the terminating NUL.
 */
int aitsm_sparkplug_topic(char *buffer, size_t capacity, enum aitsm_sparkplug_message_type type);

/** Return the next sequence number after seq, wrapping at 256. */
uint8_t aitsm_sparkplug_next_seq(uint8_t seq);

/**
 * Encode an NBIRTH payload with seq 0, the bdSeq metric and the metrics that
 * later NDATA messages carry (without values).
 */
int aitsm_sparkplug_encode_nbirth(uint8_t *buffer, size_t capacity, size_t *length,
				  uint64_t timestamp_ms, uint8_t bd_seq);

/**
 * Encode an NDATA payload with temperature and battery metrics for each
 * measurement. The measurements come from the batch buffer, so every metric is
 * marked historical and carries its own timestamp. Timestamps are converted
 * from seconds to the milliseconds Sparkplug B uses.
 */
int aitsm_sparkplug_encode_ndata(uint8_t *buffer, size_t capacity, size_t *length,
				 const struct aitsm_measurement *measurements, size_t count,
				 uint8_t seq);

#endif /* AITSM_SPARKPLUG_H_ */
```
