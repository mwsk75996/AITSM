## CMakeLists.txt
```
cmake_minimum_required(VERSION 3.20.0)

find_package(Zephyr REQUIRED HINTS $ENV{ZEPHYR_BASE})
project(aitsm_cellular_connection)

set(AITSM_GENERATED_INCLUDE_DIR ${CMAKE_CURRENT_BINARY_DIR}/generated)
file(MAKE_DIRECTORY ${AITSM_GENERATED_INCLUDE_DIR})

# Credentials are supplied by the build environment. They are written only to
# the ignored build directory and are never stored in the repository.
set(AITSM_MQTT_USERNAME "$ENV{AITSM_MQTT_USERNAME}")
set(AITSM_MQTT_PASSWORD "$ENV{AITSM_MQTT_PASSWORD}")
if(AITSM_MQTT_USERNAME STREQUAL "")
	set(AITSM_MQTT_USERNAME "thingy91x")
endif()

string(REPLACE "\\" "\\\\" AITSM_MQTT_USERNAME "${AITSM_MQTT_USERNAME}")
string(REPLACE "\"" "\\\"" AITSM_MQTT_USERNAME "${AITSM_MQTT_USERNAME}")
string(REPLACE "\\" "\\\\" AITSM_MQTT_PASSWORD "${AITSM_MQTT_PASSWORD}")
string(REPLACE "\"" "\\\"" AITSM_MQTT_PASSWORD "${AITSM_MQTT_PASSWORD}")

configure_file(
	${CMAKE_CURRENT_SOURCE_DIR}/include/mqtt_credentials.h.in
	${AITSM_GENERATED_INCLUDE_DIR}/mqtt_credentials.h
	@ONLY
)

set(AITSM_CERTS_BINARY_DIR ${CMAKE_CURRENT_BINARY_DIR}/certs)
file(MAKE_DIRECTORY ${AITSM_CERTS_BINARY_DIR})
zephyr_include_directories(${AITSM_CERTS_BINARY_DIR})
if(EXISTS ${CMAKE_CURRENT_SOURCE_DIR}/certs/ca-cert.pem)
	generate_inc_file_for_target(
		app
		${CMAKE_CURRENT_SOURCE_DIR}/certs/ca-cert.pem
		${AITSM_CERTS_BINARY_DIR}/ca-cert.pem
	)
endif()

target_include_directories(app PRIVATE include proto ${AITSM_GENERATED_INCLUDE_DIR})
target_sources(app PRIVATE
	src/main.c
	src/app_controller.c
	src/data_transmission.c
	src/sparkplug.c
	proto/sparkplug_b.pb.c
	src/measurement_service.c
	src/measurement_source.c
	src/network.c
	src/mqtt_client.c
	src/mqtt_reconnect.c
	src/mqtt_credentials_provision.c
	src/led_status.c
)
```

## KCONFIG.md
```
# Kconfig-indstillinger i `prj.conf`

Denne fil forklarer hver `CONFIG_*`-indstilling i [`prj.conf`](prj.conf): hvad
den gør, og hvorfor den er slået til for Projekt C (Thingy:91 X / nRF9151).
Kilder er NCS v3.4.0 / Zephyr 4.4.0's egne Kconfig-filer.

## GPIO og PWM (RGB-LED)

### `CONFIG_GPIO=y`
Slår GPIO-driveren til. Bruges indirekte af PWM-output til RGB-LED'en.

### `CONFIG_PWM=y`
Slår PWM-driveren (Pulse Width Modulation) til. `led_status.c` bruger tre
PWM-kanaler til at styre RGB-LED'en efter forbindelsesstatus.

## Netværk

### `CONFIG_NETWORKING=y`
Zephyrs overordnede tænd/sluk-knap for link-lag og IP-netværk. Alle øvrige
netværksindstillinger (`NET_SOCKETS`, `MQTT_LIB` osv.) ligger inde i et
`if NETWORKING`-blok i Zephyrs kildekode og er derfor ikke tilgængelige, før
denne er slået til. Trækker automatisk `NET_BUF`, `POLL` og
`ENTROPY_GENERATOR` med sig.

### `CONFIG_NET_SOCKETS=y`
Aktiverer BSD Sockets-API'et (`socket()`, `connect()`, `send()` osv.) oven på
Zephyrs netværksstak. Det er dette API, MQTT-biblioteket og applikationens
egen netværkskode bruger til at sende/modtage data.

## Logging

### `CONFIG_LOG=y`
Den globale tænd/sluk-knap for Zephyrs logging-framework. Uden den bliver
`LOG_INF()`/`LOG_ERR()`-kald slet ikke kompileret ind i firmwaren. Nødvendig
for at kunne fejlsøge LTE-forbindelse og MQTT senere.

## MQTT

### `CONFIG_MQTT_LIB=y`
Zephyrs indbyggede MQTT-klientbibliotek (oven på `NET_SOCKETS`). Bemærk:
kravspecifikationen omtaler den som `CONFIG_MQTT`, men det faktiske
Kconfig-symbol i Zephyr 4.4.0 hedder `MQTT_LIB`
(`zephyr/subsys/net/lib/mqtt/Kconfig`). `MQTT_LIB` vælger selv `NET_SOCKETS`,
men den er sat eksplicit her for tydelighed.

### `CONFIG_MQTT_HELPER=y`
NCS-specifik hjælper (`nrf/subsys/net/lib/mqtt_helper`) der binder
`MQTT_LIB` sammen med TLS og modemmets sockets på en måde der matcher Nordics
eksempler og biblioteker (f.eks. certifikat-provisionering, sikre
forbindelser via `sec_tag`). Gør det simplere at oprette en TLS-sikret
MQTT-forbindelse end at bruge `MQTT_LIB` direkte.

`MQTT_HELPER` bruges her sammen med TLS-konfigurationen nedenfor til den reelle
sikre forbindelse. Certifikatfilen er den offentlige Let’s Encrypt CA; ingen
server- eller klient-private nøgler er nødvendige for denne broker.

### TLS og MQTT-helper

`CONFIG_MQTT_LIB_TLS=y` aktiverer MQTT over TLS. `CONFIG_MQTT_HELPER_PORT=8883`
vælger brokerens TLS-port, og `CONFIG_MQTT_HELPER_SEC_TAG=42` er den interne
security tag, som certifikatet registreres under. `CONFIG_MODEM_KEY_MGMT=y`
gør det muligt at registrere den offentlige Let’s Encrypt CA direkte i
nRF9151-modemmet ved opstart, hvilket er den metode Nordics nRF91-sample bruger.
Der lægges ingen privat nøgle eller MQTT-password i repository’et.

Ved et lokalt build skal MQTT-passwordet leveres via miljøvariablen
`AITSM_MQTT_PASSWORD`; CMake genererer derefter en header i den ignorerede
build-mappe. Mangler passwordet, stopper firmwaren før LTE-forbindelsen startes.

## Cellulær forbindelse (nRF9151-modem)

### `CONFIG_NRF_MODEM_LIB=y`
Nordics modembibliotek – broen mellem applikationen og selve
LTE-modemet i nRF9151. Kræver
`CONFIG_TRUSTED_EXECUTION_NONSECURE=y`, hvilket er årsagen til at boardet
bygges som `thingy91x/nrf9151/ns` (se rod-README). Trækker selv
`NET_SOCKETS_OFFLOAD`, `NET_IPV4` og `NET_IPV6` ind (via `imply`), fordi
IP-stakken reelt køres af modemet – Zephyrs socket-API bruges kun som
grænseflade oven på modemmets offloadede sockets.

### `CONFIG_LTE_LINK_CONTROL=y`
NCS-bibliotek til at styre og overvåge LTE-forbindelsen: opkobling,
netværksregistrering, PSM/eDRX, cellemålinger m.m. Bruges til selve
opkoblingslogikken, adskilt fra `NRF_MODEM_LIB` som blot giver adgang til
modemmet.

### `CONFIG_LTE_NETWORK_MODE_NBIOT=y`
Vælger netværksmoden NB-IoT i lte_lc's `LTE_NETWORK_MODE`-choice
(`nrf/lib/lte_link_control/Kconfig`). Choiceens standardværdi er
`LTE_NETWORK_MODE_LTE_M_NBIOT_GPS` (LTE-M, NB-IoT og GNSS), men siden issue #25
skal enheden **udelukkende** bruge NB-IoT:

- NB-IoT er valgt med hensyn til strømforbrug og dækning i projektkonteksten
  (relateret til issue #6 om cellulær forbindelse og strømforbrug).
- LTE-M og alle kombinationsmoden (`LTE_M`, `LTE_M_GPS`, `LTE_M_NBIOT`,
  `LTE_M_NBIOT_GPS`) er dermed udeladt af choice'en og kan ikke vælges af
  modemmet som fald-back.
- `tests/nb_iot_config/` indeholder en compile-time-test, der fejler buildet,
  hvis kombinationsmoden bliver aktiveret igen.

NB-IoT-kun stiller krav til både SIM-kortet og operatøren - se
[`README.md`](README.md), afsnittet "Krav til SIM-kort og operatør".

## Relevant, men endnu ikke konfigureret

- **PSM/eDRX-indstillinger** (fx `CONFIG_LTE_LC_PSM_MODULE` og
  `CONFIG_LTE_LC_EDRX_MODULE`) hører til strømforbrugs-issues, ikke
  grundopsætningen.

## AITSM data transmission

De projektspecifikke `CONFIG_AITSM_*`-indstillinger ligger i [`Kconfig`](Kconfig)
og gør transmissionsprofilen ændrbar uden kodeændringer.

### `CONFIG_AITSM_MEASUREMENT_INTERVAL_SECONDS`

Måleintervallet. Det er begrænset til 5-15 sekunder af Kconfig, mens MQTT-
afsendelsen kan ske sjældnere, når batching er valgt. Standardværdien er 15
sekunder.

### `CONFIG_AITSM_TRANSMISSION_BATCH` og `CONFIG_AITSM_TRANSMISSION_SINGLE`

En choice, der vælger mellem batching og én måling pr. MQTT-besked. Batching er
standardprofilen; single er beregnet til test og fejlsøgning.

### `CONFIG_AITSM_BATCH_INTERVAL_SECONDS`

Maksimal tid fra første måling i en batch til batchen er klar til afsendelse.
Standardværdien er 300 sekunder.

### `CONFIG_AITSM_BATCH_MAX_SAMPLES`

Fast øvre grænse for antallet af målinger i bufferens batch. Standardværdien er
20, hvilket svarer til fem minutter ved et 15-sekunders måleinterval. Maks. 32.

### `CONFIG_AITSM_TRANSMISSION_PAYLOAD_SIZE`

Fast maksimal payload-størrelse på 2048 bytes. Grænsen forhindrer ukontrolleret
hukommelsesforbrug. Den skal kunne rumme en fuld SparkplugB NDATA med
`CONFIG_AITSM_BATCH_MAX_SAMPLES` målinger (ca. 70 bytes pr. måling); et
`BUILD_ASSERT` afviser ugyldige kombinationer.

## Strømbesparelse (#23)

`prj.conf` sætter `CONFIG_LTE_LC_PSM_MODULE=y`, `CONFIG_LTE_PSM_REQ=y` med
`CONFIG_LTE_PSM_REQ_FORMAT_SECONDS=y`, `CONFIG_LTE_PSM_REQ_RPTAU_SECONDS=3600` og
`CONFIG_LTE_PSM_REQ_RAT_SECONDS=10`. Nettet bestemmer de tildelte værdier.
`CONFIG_MQTT_KEEPALIVE=1200` skal være længere end batch-intervallet, så
keepalive-ping ikke vækker modemmet. `overlay-low-power.conf` slår konsol og
logning fra til målinger.

## AITSM SparkplugB (#66)

`CONFIG_AITSM_SPARKPLUG_GROUP_ID` (standard `aitsm`) og
`CONFIG_AITSM_SPARKPLUG_EDGE_NODE_ID` (standard `thingy91x`) indgår i topicet
`spBv1.0/<group_id>/<message_type>/<edge_node_id>`. `CONFIG_NANOPB=y` er sat i
`prj.conf` til protobuf-kodningen.

## AITSM MQTT-worker (#75)

`CONFIG_AITSM_MQTT_WORKQUEUE_STACK_SIZE` reserverer 4096 bytes til den dedikerede MQTT-workqueue. `CONFIG_AITSM_MQTT_WORKQUEUE_PRIORITY` er som standard 5 (preemptiv), så blokerende DNS-, TCP-, TLS- og publish-kald ikke optager systemworkqueue. Begge kan ændres i et overlay; stacken er begrænset til 2048–16384 bytes og prioriteten til 0–14.

Publish flyttes også: NCS' `mqtt_helper_publish()` kalder Zephyrs synkrone `mqtt_publish()`, som tager klientens mutex og skriver til socketten. Workeren ejer en separat payloadbuffer og accepterer højst ét ventende publish. Afsendelsesfejl og PUBACK sendes tilbage som app-events. Måleservicens tilstand og app-events behandles fortsat på systemworkqueue.

## AITSM MQTT-reconnect (#76)

`CONFIG_AITSM_MQTT_RECONNECT_INITIAL_DELAY_SECONDS` er som standard 5 sekunder.
Efter hvert mislykket forsøg fordobles ventetiden til højst
`CONFIG_AITSM_MQTT_RECONNECT_MAX_DELAY_SECONDS` (standard 60 sekunder).
Begge har intervallet 1–3600; buildet afviser en startværdi over loftet.

MQTT-CONNACK nulstiller backoff. LTE-tab annullerer ventende retries, og ny
LTE-registrering forbinder straks. ERROR og DISCONNECTED fra samme forsøg
udløser kun én timer. Timeren ligger på systemworkqueue; connect/disconnect
udføres på den separate MQTT-workqueue.

## AITSM PUBACK-ventetid (#87)

`CONFIG_AITSM_MQTT_PUBACK_TIMEOUT_SECONDS` er 30 s som standard.
Efter genlevering af samme payload/message-id med `DUP=1` fordobles ventetiden
op til `CONFIG_AITSM_MQTT_PUBACK_MAX_DELAY_SECONDS` (standard 300 s).
Begge har intervallet 1–3600; initial ventetid over loftet afvises ved build.
Timeren starter efter socket-skrivningen og ligger på MQTT-workqueue.
ACK/disconnect annullerer den; nye målinger ændrer ikke deadline. En sund
forbindelse med normal ACK giver ingen genleveringer eller ekstra TLS-kald.

## AITSM logging

### `CONFIG_AITSM_LOG_LEVEL`

Standardlog-niveauet for alle AITSM-moduler, brugt i
`LOG_MODULE_REGISTER(<modul>, CONFIG_AITSM_LOG_LEVEL)`. 0 = off, 1 = error,
2 = warning, 3 = info (standard), 4 = debug. Sæt den til 4 lokalt for at se
detaljeret debug-output, fx LTE-modeopdateringer.
```

## Kconfig
```
menu "AITSM data transmission"

choice AITSM_TRANSMISSION_MODE
	prompt "Transmission mode"
	default AITSM_TRANSMISSION_BATCH
	help
		Select whether measurements are sent one at a time or collected
		in a fixed-size batch before transmission.

	config AITSM_TRANSMISSION_SINGLE
		bool "Single measurement per MQTT message"

	config AITSM_TRANSMISSION_BATCH
		bool "Batch measurements before MQTT transmission"

endchoice

config AITSM_MEASUREMENT_INTERVAL_SECONDS
	int "Measurement interval in seconds"
	range 5 15
	default 15
	help
		Interval used by the measurement producer. The allowed range follows
		the project requirement; MQTT transmission may happen less often
		when batching is selected.

config AITSM_BATCH_INTERVAL_SECONDS
	int "Batch transmission interval in seconds"
	range 1 3600
	default 300
	depends on AITSM_TRANSMISSION_BATCH
	help
		Maximum time from the first measurement in a batch until the batch
		is ready for transmission.

config AITSM_BATCH_MAX_SAMPLES
	int "Maximum measurements per batch"
	range 1 32
	default 20
	depends on AITSM_TRANSMISSION_BATCH
	help
		Fixed upper bound for the in-memory measurement buffer. With the
		default values, 20 measurements represent five minutes at 15-second
		measurement intervals.

config AITSM_TRANSMISSION_PAYLOAD_SIZE
	int "Maximum telemetry payload size"
	range 256 4096
	default 2048
	help
		Maximum number of bytes reserved for a serialized telemetry
		payload. The fixed limit prevents unbounded memory use.

endmenu

menu "AITSM SparkplugB"

config AITSM_SPARKPLUG_GROUP_ID
	string "Sparkplug B group ID"
	default "aitsm"
	help
		Group ID in the topic namespace spBv1.0/<group_id>/<message_type>/<edge_node_id>.

config AITSM_SPARKPLUG_EDGE_NODE_ID
	string "Sparkplug B edge node ID"
	default "thingy91x"
	help
		Edge node ID in the topic namespace. Also used as the device identity
		in the cloud.

endmenu

menu "AITSM MQTT worker"

config AITSM_MQTT_WORKQUEUE_STACK_SIZE
	int "MQTT workqueue stack size"
	range 2048 16384
	default 4096
	help
		Stack reserved for blocking MQTT connect and publish operations.

config AITSM_MQTT_WORKQUEUE_PRIORITY
	int "MQTT workqueue priority"
	range 0 14
	default 5
	help
		Preemptible priority of the dedicated MQTT workqueue.

config AITSM_MQTT_RECONNECT_INITIAL_DELAY_SECONDS
	int "Initial MQTT reconnect delay"
	range 1 3600
	default 5

config AITSM_MQTT_RECONNECT_MAX_DELAY_SECONDS
	int "Maximum MQTT reconnect delay"
	range 1 3600
	default 60

config AITSM_MQTT_PUBACK_TIMEOUT_SECONDS
	int "Initial wait for broker PUBACK"
	range 1 3600
	default 30
	help
		Only a missing PUBACK triggers retransmission of the same MQTT 3.1.1
		payload and message identifier, without creating a new TLS connection.

config AITSM_MQTT_PUBACK_MAX_DELAY_SECONDS
	int "Maximum delay between missing-PUBACK retries"
	range 1 3600
	default 300
	help
		Double the wait after each retransmission up to this bound. ACK and
		disconnect cancel the timer; new samples never change its deadline.

endmenu

menu "AITSM logging"

config AITSM_LOG_LEVEL
	int "AITSM firmware log level"
	range 0 4
	default 3
	help
		Default log level for the AITSM modules: 0 = off, 1 = error,
		2 = warning, 3 = info, 4 = debug. Use 4 locally to see
		verbose debug output, for example LTE mode updates.

endmenu

source "Kconfig.zephyr"
```

## prj.conf
```kconfig
CONFIG_GPIO=y
CONFIG_PWM=y
# Network, MQTT and cellular modem support
CONFIG_NETWORKING=y
CONFIG_NET_NATIVE=n
CONFIG_NET_SOCKETS=y
CONFIG_NET_SOCKETS_OFFLOAD=y
CONFIG_LOG=y
CONFIG_MQTT_LIB=y
CONFIG_MQTT_LIB_TLS=y
CONFIG_NRF_MODEM_LIB=y
CONFIG_LTE_LINK_CONTROL=y
CONFIG_MODEM_INFO=y
CONFIG_DATE_TIME=y
CONFIG_DATE_TIME_MODEM=y
CONFIG_DATE_TIME_NTP=n
CONFIG_MQTT_HELPER=y
CONFIG_MQTT_HELPER_PORT=8883
CONFIG_MQTT_HELPER_SEC_TAG=42
CONFIG_MODEM_KEY_MGMT=y
CONFIG_SENSOR=y
CONFIG_NPM13XX_CHARGER=y

# NB-IoT only: the device must not fall back to LTE-M (see issue #25).
CONFIG_LTE_NETWORK_MODE_NBIOT=y

# Low power (#23): request PSM so the modem sleeps between batch uploads. The
# MQTT keepalive is longer than the batch interval (300 s), so keepalive pings
# do not wake the modem in between; the batches themselves keep the connection
# and the operator's NAT mapping alive.
CONFIG_LTE_LC_PSM_MODULE=y
CONFIG_LTE_PSM_REQ=y
CONFIG_LTE_PSM_REQ_FORMAT_SECONDS=y
CONFIG_LTE_PSM_REQ_RPTAU_SECONDS=3600
CONFIG_LTE_PSM_REQ_RAT_SECONDS=10
CONFIG_MQTT_KEEPALIVE=1200

# LTE and modem libraries need more heap/stack than the LED-only application.
CONFIG_HEAP_MEM_POOL_SIZE=2048
CONFIG_MAIN_STACK_SIZE=2048

# Data/transmission profile (issues #30-31).
CONFIG_AITSM_TRANSMISSION_BATCH=y
CONFIG_AITSM_MEASUREMENT_INTERVAL_SECONDS=15
CONFIG_AITSM_BATCH_INTERVAL_SECONDS=300
CONFIG_AITSM_BATCH_MAX_SAMPLES=28
CONFIG_NANOPB=y
```

## overlay-at-shell.conf
```kconfig
# Test overlay: AT commands over the USB serial console.
#
# Used for hardware tests (issue #12), e.g. simulating an LTE outage with
# "at AT+CFUN=4" followed by "at AT+CFUN=1". Not part of the standard build.
#
# west build -b thingy91x/nrf9151/ns -d build/thingy91x_at_shell app \
#   -- -DEXTRA_CONF_FILE=overlay-at-shell.conf

CONFIG_SHELL=y
CONFIG_AT_SHELL=y
# AT queries contain '?'; shell wildcard expansion would consume them.
CONFIG_SHELL_WILDCARD=n
# "kernel reboot cold" for a clean start before each test.
CONFIG_REBOOT=y
CONFIG_SHELL_STACK_SIZE=3072
```

## src/main.c
```c
#include <zephyr/kernel.h>
#include <zephyr/logging/log.h>

#include <data_transmission.h>
#include <app_controller.h>
#include <led_status.h>
#include <measurement_service.h>
#include <network.h>

LOG_MODULE_REGISTER(main, CONFIG_AITSM_LOG_LEVEL);

int main(void)
{
	int err;

	LOG_INF("AITSM firmware starting");

	err = led_status_init();
	if (err != 0) {
		LOG_ERR("RGB LED initialization failed, error: %d", err);
		return err;
	}

	err = aitsm_data_transmission_init();
	if (err != 0) {
		LOG_ERR("Data transmission initialization failed, error: %d",
			err);
		return err;
	}

	err = aitsm_measurement_service_init();
	if (err != 0) {
		LOG_ERR("Measurement service initialization failed, error: %d",
			err);
		return err;
	}

	aitsm_app_controller_init();
	err = network_init();
	if (err != 0) {
		return err;
	}

	while (true) {
		k_sleep(K_FOREVER);
	}

	return 0;
}
```

## include/app_controller.h
```c
#ifndef AITSM_APP_CONTROLLER_H_
#define AITSM_APP_CONTROLLER_H_

/** Events exchanged between asynchronous network modules and the application. */
enum aitsm_app_event_type {
	AITSM_APP_EVENT_LTE_SEARCHING,
	AITSM_APP_EVENT_LTE_CONNECTED,
	AITSM_APP_EVENT_LTE_DISCONNECTED,
	AITSM_APP_EVENT_MQTT_CONNECTED,
	AITSM_APP_EVENT_MQTT_DISCONNECTED,
	AITSM_APP_EVENT_MQTT_ERROR,
	AITSM_APP_EVENT_MQTT_PUBLISH_RESULT,
};

/** Post an event to the application workqueue without blocking a callback. */
int aitsm_app_post_event(enum aitsm_app_event_type type, int value);

/** Initialize controller state before starting LTE or MQTT callbacks. */
void aitsm_app_controller_init(void);

#endif /* AITSM_APP_CONTROLLER_H_ */
```

## include/data_transmission.h
```c
#ifndef AITSM_DATA_TRANSMISSION_H_
#define AITSM_DATA_TRANSMISSION_H_

#include <stdbool.h>
#include <stddef.h>
#include <stdint.h>

#define AITSM_DATA_TRANSMISSION_PAYLOAD_SIZE \
	CONFIG_AITSM_TRANSMISSION_PAYLOAD_SIZE

/** Selected way of grouping measurements for MQTT transmission. */
enum aitsm_transmission_mode {
	AITSM_TRANSMISSION_MODE_SINGLE,
	AITSM_TRANSMISSION_MODE_BATCH,
};

/** One measurement in the transmission buffer. */
struct aitsm_measurement {
	/** Device timestamp in seconds since the device time base. */
	int64_t timestamp;
	/** Temperature in hundredths of a degree Celsius. */
	int32_t temperature_centi_celsius;
	/** Battery percentage in hundredths of a percent. */
	uint16_t battery_centi_percent;
};

/** Initialize and empty the fixed-size transmission buffer. */
int aitsm_data_transmission_init(void);

/** Return the Kconfig-selected transmission mode. */
enum aitsm_transmission_mode aitsm_data_transmission_mode(void);

/** Store a measurement without allocating memory dynamically. */
int aitsm_data_transmission_add(const struct aitsm_measurement *measurement);

/** True when another reading can be retained without overwriting data. */
bool aitsm_data_transmission_has_capacity(void);

/** Return whether the current buffer should be sent now. */
bool aitsm_data_transmission_should_flush(int64_t now);

/**
 * Serialize the current measurements into the transport payload.
 *
 * The JSON envelope is deliberately kept behind this API so the serializer can
 * later be replaced by SparkplugB without changing the buffer or MQTT client.
 */
int aitsm_data_transmission_format(char *buffer, size_t capacity,
				   size_t *measurement_count);

/** Remove measurements after their MQTT publish has been acknowledged. */
int aitsm_data_transmission_commit(size_t measurement_count);

#endif /* AITSM_DATA_TRANSMISSION_H_ */
```

## include/led_fader.h
```c
#ifndef AITSM_LED_FADER_H_
#define AITSM_LED_FADER_H_

/**
 * Run the RGB LED fade loop.
 *
 * This function only returns when one or more configured PWM devices are not
 * ready.
 */
void led_fader_run(void);

#endif
```

## include/led_status.h
```c
#ifndef AITSM_LED_STATUS_H_
#define AITSM_LED_STATUS_H_

/** LED indication for the cellular connection state. */
enum led_status {
	/** The modem is searching for a network. */
	LED_STATUS_CONNECTING,
	/** The modem is registered on the network (NB-IoT only). */
	LED_STATUS_CONNECTED,
	/** The modem is not registered on a network. */
	LED_STATUS_DISCONNECTED,
	/** A modem or LED initialization error occurred. */
	LED_STATUS_ERROR,
};

/** Initialize the RGB LED and set it to the disconnected state. */
int led_status_init(void);

/** Set the RGB LED to the requested connection state. */
int led_status_set(enum led_status status);

#endif /* AITSM_LED_STATUS_H_ */
```

## include/measurement_service.h
```c
#ifndef AITSM_MEASUREMENT_SERVICE_H_
#define AITSM_MEASUREMENT_SERVICE_H_

#include <stdint.h>

/** Initialize the periodic sensor sampling service. */
int aitsm_measurement_service_init(void);


/** Start periodic sampling after the modem is initialized (nonblocking). */
int aitsm_measurement_service_start(void);

/** Cumulative skipped sample slots due to a full buffer; system workqueue only. */
uint32_t aitsm_measurement_service_dropped_samples(void);

/** Enable MQTT transmission and drain retained readings. */
void aitsm_measurement_service_mqtt_connected(void);

/** Stop transmission; sampling and retention continue during MQTT outages. */
void aitsm_measurement_service_mqtt_disconnected(void);

/** Complete or retry the currently pending MQTT transmission. */
void aitsm_measurement_service_publish_result(int result);

#endif /* AITSM_MEASUREMENT_SERVICE_H_ */
```

## include/measurement_source.h
```c
#ifndef AITSM_MEASUREMENT_SOURCE_H_
#define AITSM_MEASUREMENT_SOURCE_H_
struct aitsm_measurement;
/** Read local sensors and valid UTC time; performs no MQTT transmission. */
int aitsm_measurement_read(struct aitsm_measurement *measurement);
#endif
```

## include/mqtt_client.h
```c
#ifndef AITSM_MQTT_CLIENT_H_
#define AITSM_MQTT_CLIENT_H_

#include <stddef.h>
#include <stdbool.h>
#include <stdint.h>

/** Initialize the TLS-enabled MQTT helper and its callbacks. */
int aitsm_mqtt_init(void);

/** Schedule an MQTT connection attempt after LTE registration. */
int aitsm_mqtt_connect(void);

/** Gate queued connection attempts on LTE registration (nonblocking). */
void aitsm_mqtt_set_lte_available(bool available);

/** Invalidate the current session and queue a disconnect (nonblocking). */
int aitsm_mqtt_disconnect(void);

/** Copy and queue a payload on the dedicated MQTT worker.
 * Returns 0 when accepted, -EBUSY while writing or awaiting PUBACK.
 * token receives the identifier used to correlate its completion event.
 * Completion/failure is reported through AITSM_APP_EVENT_MQTT_PUBLISH_RESULT.
 * A successful socket write is only completed by the broker's PUBACK.
 */
int aitsm_mqtt_publish_payload(const char *payload, size_t payload_length, uint32_t *token);

#endif /* AITSM_MQTT_CLIENT_H_ */
```

## include/mqtt_reconnect.h
```c
#ifndef AITSM_MQTT_RECONNECT_H_
#define AITSM_MQTT_RECONNECT_H_
#include <stdbool.h>
#include <stdint.h>

enum aitsm_reconnect_event {
	AITSM_RECONNECT_LTE_UP,
	AITSM_RECONNECT_LTE_DOWN,
	AITSM_RECONNECT_MQTT_UP,
	AITSM_RECONNECT_FAILURE,
	AITSM_RECONNECT_TIMER,
};
enum aitsm_reconnect_phase {
	AITSM_RECONNECT_OFFLINE,
	AITSM_RECONNECT_CONNECTING,
	AITSM_RECONNECT_WAITING,
	AITSM_RECONNECT_CONNECTED,
};
enum aitsm_reconnect_action {
	AITSM_RECONNECT_NONE,
	AITSM_RECONNECT_CONNECT,
	AITSM_RECONNECT_SCHEDULE,
	AITSM_RECONNECT_CANCEL,
};
struct aitsm_reconnect_result {
	enum aitsm_reconnect_action action;
	uint32_t delay_seconds;
};
/* Owned exclusively by the app controller on the system workqueue. */
struct aitsm_reconnect_state {
	bool lte_available;
	enum aitsm_reconnect_phase phase;
	uint32_t next_delay_seconds;
};
void aitsm_reconnect_init(struct aitsm_reconnect_state *state);
struct aitsm_reconnect_result aitsm_reconnect_handle(
	struct aitsm_reconnect_state *state, enum aitsm_reconnect_event event);
#endif
```

## include/sparkplug.h
```c
#ifndef AITSM_SPARKPLUG_H_
#define AITSM_SPARKPLUG_H_

#include <stdbool.h>
#include <stddef.h>
#include <stdint.h>

#include <data_transmission.h>

/** Sparkplug B v1.0 message types used by the edge node. */
enum aitsm_sparkplug_message_type {
	AITSM_SPARKPLUG_NBIRTH,
	AITSM_SPARKPLUG_NDATA,
};

/** Sequence numbers wrap from 255 to 0 (Sparkplug B v1.0, section 6.4.19). */
#define AITSM_SPARKPLUG_SEQ_MODULO 256U

/** Metric names shared by NBIRTH and NDATA. */
#define AITSM_SPARKPLUG_METRIC_TEMPERATURE "temperature"
#define AITSM_SPARKPLUG_METRIC_BATTERY "battery"
#define AITSM_SPARKPLUG_METRIC_BDSEQ "bdSeq"

/**
 * Upper bound for an NDATA payload with count measurements: payload header
 * (timestamp and seq) plus two metrics per measurement, each with name,
 * timestamp, datatype, historical flag and a float value.
 */
#define AITSM_SPARKPLUG_NDATA_MAX_SIZE(count) (16U + (count) * 70U)

/**
 * Write the topic spBv1.0/<group_id>/<message type>/<edge_node_id>.
 * Returns -EMSGSIZE if it does not fit, including the terminating NUL.
 */
int aitsm_sparkplug_topic(char *buffer, size_t capacity,
			  enum aitsm_sparkplug_message_type type);

/** Return the next sequence number after seq, wrapping at 256. */
uint8_t aitsm_sparkplug_next_seq(uint8_t seq);

/**
 * Encode an NBIRTH payload with seq 0, the bdSeq metric and the metrics that
 * later NDATA messages carry (without values).
 */
int aitsm_sparkplug_encode_nbirth(uint8_t *buffer, size_t capacity, size_t *length,
				  uint64_t timestamp_ms, uint8_t bd_seq);

/**
 * Encode an NDATA payload with temperature and battery metrics for each
 * measurement. Metrics of buffered readings are marked historical, so the
 * consumer can tell them from live values. Measurement timestamps are
 * converted from seconds to the milliseconds Sparkplug B uses.
 */
int aitsm_sparkplug_encode_ndata(uint8_t *buffer, size_t capacity, size_t *length,
				 const struct aitsm_measurement *measurements, size_t count,
				 uint8_t seq, bool historical);

#endif /* AITSM_SPARKPLUG_H_ */
```

## src/app_controller.c
```c
#include <zephyr/kernel.h>
#include <zephyr/logging/log.h>

#include <app_controller.h>
#include <led_status.h>
#include <measurement_service.h>
#include <mqtt_client.h>
#include <mqtt_reconnect.h>

LOG_MODULE_REGISTER(app_controller, CONFIG_AITSM_LOG_LEVEL);

#define AITSM_APP_EVENT_QUEUE_LENGTH 16

static struct aitsm_reconnect_state reconnect;
static void reconnect_work_handler(struct k_work *work);
static K_WORK_DELAYABLE_DEFINE(reconnect_work, reconnect_work_handler);

static void apply_reconnect(enum aitsm_reconnect_event event)
{
	struct aitsm_reconnect_result result = aitsm_reconnect_handle(&reconnect, event);
	switch (result.action) {
	case AITSM_RECONNECT_CONNECT: {
		int err = aitsm_mqtt_connect();
		if (err < 0) {
			(void)aitsm_app_post_event(AITSM_APP_EVENT_MQTT_ERROR, err);
		}
		break;
	}
	case AITSM_RECONNECT_SCHEDULE:
		LOG_INF("MQTT-reconnect om %u sekunder", result.delay_seconds);
		(void)k_work_reschedule(&reconnect_work, K_SECONDS(result.delay_seconds));
		break;
	case AITSM_RECONNECT_CANCEL:
		(void)k_work_cancel_delayable(&reconnect_work);
		break;
	case AITSM_RECONNECT_NONE:
		break;
	}
}

static void reconnect_work_handler(struct k_work *work)
{
	ARG_UNUSED(work);
	apply_reconnect(AITSM_RECONNECT_TIMER);
}

void aitsm_app_controller_init(void)
{
	aitsm_reconnect_init(&reconnect);
}

static void lte_lost(void)
{
	aitsm_mqtt_set_lte_available(false);
	aitsm_measurement_service_mqtt_disconnected();
	apply_reconnect(AITSM_RECONNECT_LTE_DOWN);
}

struct aitsm_app_event {
	enum aitsm_app_event_type type;
	int value;
};

K_MSGQ_DEFINE(aitsm_app_event_queue,
	      sizeof(struct aitsm_app_event),
	      AITSM_APP_EVENT_QUEUE_LENGTH,
	      4);

static void handle_event(const struct aitsm_app_event *event)
{
	switch (event->type) {
	case AITSM_APP_EVENT_LTE_SEARCHING:
		lte_lost();
		(void)led_status_set(LED_STATUS_SEARCHING);
		break;
	case AITSM_APP_EVENT_LTE_CONNECTED:
		aitsm_mqtt_set_lte_available(true);
		if (reconnect.phase != AITSM_RECONNECT_CONNECTED) {
			(void)led_status_set(LED_STATUS_LTE_CONNECTED);
		}
		apply_reconnect(AITSM_RECONNECT_LTE_UP);
		break;
	case AITSM_APP_EVENT_LTE_DISCONNECTED:
		LOG_INF("LTE-afbrudt event behandlet: %d", event->value);
		lte_lost();
		(void)led_status_set(LED_STATUS_DISCONNECTED);
		break;
	case AITSM_APP_EVENT_MQTT_CONNECTED:
		if (!reconnect.lte_available) {
			(void)aitsm_mqtt_disconnect();
			break;
		}
		apply_reconnect(AITSM_RECONNECT_MQTT_UP);
		LOG_INF("Cloud MQTT event modtaget: forbundet");
		(void)led_status_set(LED_STATUS_MQTT_CONNECTED);
		aitsm_measurement_service_mqtt_connected();
		break;
	case AITSM_APP_EVENT_MQTT_DISCONNECTED:
		LOG_WRN("Cloud MQTT event modtaget: afbrudt (%d)", event->value);
		if (!reconnect.lte_available) {
			(void)led_status_set(LED_STATUS_DISCONNECTED);
		} else if (reconnect.phase != AITSM_RECONNECT_WAITING) {
			/* A duplicate disconnect must not overwrite a preceding error. */
			(void)led_status_set(LED_STATUS_LTE_CONNECTED);
		}
		aitsm_measurement_service_mqtt_disconnected();
		apply_reconnect(AITSM_RECONNECT_FAILURE);
		break;
	case AITSM_APP_EVENT_MQTT_ERROR:
		LOG_ERR("Cloud MQTT-fejl modtaget af applikationen: %d", event->value);
		aitsm_measurement_service_mqtt_disconnected();
		if (reconnect.lte_available) {
			(void)led_status_set(LED_STATUS_ERROR);
			(void)aitsm_mqtt_disconnect();
		}
		apply_reconnect(AITSM_RECONNECT_FAILURE);
		break;
	case AITSM_APP_EVENT_MQTT_PUBLISH_RESULT:
		aitsm_measurement_service_publish_result(event->value);
		if (event->value == 0) {
			LOG_INF("Cloud MQTT publish-event modtaget: succes");
			(void)led_status_set(LED_STATUS_PUBLISH_OK);
		} else {
			LOG_ERR("Cloud MQTT publish-event modtaget: fejl (%d)",
				event->value);
			(void)led_status_set(LED_STATUS_PUBLISH_ERROR);
		}
		break;
	default:
		break;
	}
}

static void app_event_work_handler(struct k_work *work)
{
	ARG_UNUSED(work);

	while (true) {
		struct aitsm_app_event event;

		if (k_msgq_get(&aitsm_app_event_queue, &event, K_NO_WAIT) != 0) {
			break;
		}

		handle_event(&event);
	}
}

K_WORK_DEFINE(aitsma_app_event_work, app_event_work_handler);

int aitsm_app_post_event(enum aitsm_app_event_type type, int value)
{
	const struct aitsm_app_event event = {
		.type = type,
		.value = value,
	};
	int err = k_msgq_put(&aitsm_app_event_queue, &event, K_NO_WAIT);
	if (err != 0) {
		LOG_ERR("Applikations-eventkø er fuld, event tabt: %d", type);
		return err;
	}

	return k_work_submit(&aitsma_app_event_work);
}
```

## src/data_transmission.c
```c
#include <errno.h>
#include <stdint.h>
#include <string.h>

#include <zephyr/kernel.h>
#include <zephyr/logging/log.h>
#include <zephyr/sys/util.h>

#include <data_transmission.h>
#include <sparkplug.h>

LOG_MODULE_REGISTER(data_transmission, CONFIG_AITSM_LOG_LEVEL);

#if defined(CONFIG_AITSM_TRANSMISSION_BATCH)
#define AITSM_MAX_MEASUREMENTS CONFIG_AITSM_BATCH_MAX_SAMPLES
#else
#define AITSM_MAX_MEASUREMENTS 1
#endif

/* A full buffer must always fit in one NDATA payload, otherwise it could
 * never be sent and the buffer would stay full.
 */
BUILD_ASSERT(AITSM_DATA_TRANSMISSION_PAYLOAD_SIZE >=
		     AITSM_SPARKPLUG_NDATA_MAX_SIZE(AITSM_MAX_MEASUREMENTS),
	     "CONFIG_AITSM_TRANSMISSION_PAYLOAD_SIZE is too small for a full batch "
	     "of CONFIG_AITSM_BATCH_MAX_SAMPLES worst-case measurements");

static struct aitsm_measurement measurement_buffer[AITSM_MAX_MEASUREMENTS];
static size_t measurement_count;
static int64_t first_measurement_timestamp;
static uint8_t next_seq = 1;
static bool initialized;
static struct k_mutex measurement_mutex;

int aitsm_data_transmission_init(void)
{
	k_mutex_init(&measurement_mutex);
	k_mutex_lock(&measurement_mutex, K_FOREVER);
	memset(measurement_buffer, 0, sizeof(measurement_buffer));
	measurement_count = 0;
	first_measurement_timestamp = 0;
	next_seq = 1;
	initialized = true;
	k_mutex_unlock(&measurement_mutex);

	LOG_INF("Data transmission initialiseret: %s, måleinterval %d sekunder",
#if defined(CONFIG_AITSM_TRANSMISSION_BATCH)
		"batch",
#else
		"single",
#endif
		CONFIG_AITSM_MEASUREMENT_INTERVAL_SECONDS);

	return 0;
}

enum aitsm_transmission_mode aitsm_data_transmission_mode(void)
{
#if defined(CONFIG_AITSM_TRANSMISSION_BATCH)
	return AITSM_TRANSMISSION_MODE_BATCH;
#else
	return AITSM_TRANSMISSION_MODE_SINGLE;
#endif
}

int aitsm_data_transmission_add(const struct aitsm_measurement *measurement)
{
	if (measurement == NULL) {
		return -EINVAL;
	}

	if (!initialized) {
		return -EAGAIN;
	}

	k_mutex_lock(&measurement_mutex, K_FOREVER);

#if defined(CONFIG_AITSM_TRANSMISSION_SINGLE)
	if (measurement_count != 0) {
		k_mutex_unlock(&measurement_mutex);
		return -EBUSY;
	}
#endif

	if (measurement_count >= ARRAY_SIZE(measurement_buffer)) {
		k_mutex_unlock(&measurement_mutex);
		LOG_ERR("Målebuffer fuld; måling forkastet");
		return -ENOSPC;
	}

	if (measurement_count == 0) {
		first_measurement_timestamp = measurement->timestamp;
	}

	measurement_buffer[measurement_count++] = *measurement;
	k_mutex_unlock(&measurement_mutex);

	return 0;
}

bool aitsm_data_transmission_has_capacity(void)
{
	if (!initialized) {
		return false;
	}
	k_mutex_lock(&measurement_mutex, K_FOREVER);
	bool available = measurement_count < ARRAY_SIZE(measurement_buffer);
	k_mutex_unlock(&measurement_mutex);
	return available;
}

bool aitsm_data_transmission_should_flush(int64_t now)
{
	bool flush;

	if (!initialized) {
		return false;
	}

	k_mutex_lock(&measurement_mutex, K_FOREVER);

#if defined(CONFIG_AITSM_TRANSMISSION_SINGLE)
	flush = measurement_count > 0;
#else
	flush = measurement_count > 0 && (measurement_count >= ARRAY_SIZE(measurement_buffer) ||
		(now >= first_measurement_timestamp &&
		 /* The batch covers the interval: send when the next measurement would
		  * fall outside it, so 300 s at 15 s gives 20 measurements.
		  */
		 now - first_measurement_timestamp + CONFIG_AITSM_MEASUREMENT_INTERVAL_SECONDS >=
			 CONFIG_AITSM_BATCH_INTERVAL_SECONDS));
#endif

	k_mutex_unlock(&measurement_mutex);
	return flush;
}

int aitsm_data_transmission_format(uint8_t *buffer, size_t capacity, size_t *length,
				   size_t *formatted_count)
{
	int err;

	if (buffer == NULL || length == NULL || formatted_count == NULL || capacity == 0) {
		return -EINVAL;
	}

	if (!initialized) {
		return -EAGAIN;
	}

	k_mutex_lock(&measurement_mutex, K_FOREVER);
	if (measurement_count == 0) {
		k_mutex_unlock(&measurement_mutex);
		return -ENODATA;
	}

	/* The seq is only advanced by commit, so a resend after a lost PUBACK
	 * carries the same seq as the first attempt.
	 */
	err = aitsm_sparkplug_encode_ndata(buffer, capacity, length, measurement_buffer,
					   measurement_count, next_seq,
					   aitsm_data_transmission_mode() ==
						   AITSM_TRANSMISSION_MODE_BATCH);
	if (err == 0) {
		*formatted_count = measurement_count;
	}

	k_mutex_unlock(&measurement_mutex);
	return err;
}

void aitsm_data_transmission_start_session(void)
{
	k_mutex_lock(&measurement_mutex, K_FOREVER);
	next_seq = 1;
	k_mutex_unlock(&measurement_mutex);
}

int aitsm_data_transmission_commit(size_t count)
{
	if (!initialized) {
		return -EAGAIN;
	}

	k_mutex_lock(&measurement_mutex, K_FOREVER);
	if (count > measurement_count) {
		k_mutex_unlock(&measurement_mutex);
		return -EINVAL;
	}

	if (count != 0) {
		memmove(measurement_buffer, &measurement_buffer[count],
			(measurement_count - count) * sizeof(measurement_buffer[0]));
		measurement_count -= count;
		next_seq = aitsm_sparkplug_next_seq(next_seq);
		first_measurement_timestamp = measurement_count == 0 ? 0 :
			measurement_buffer[0].timestamp;
	}

	k_mutex_unlock(&measurement_mutex);
	return 0;
}
```

## src/led_fader.c
```c
#include <stdint.h>

#include <zephyr/drivers/pwm.h>
#include <zephyr/kernel.h>

#include <led_fader.h>

#define RED_LED_NODE DT_ALIAS(pwm_led0)
#define GREEN_LED_NODE DT_ALIAS(pwm_led1)
#define BLUE_LED_NODE DT_ALIAS(pwm_led2)

#if !DT_NODE_HAS_STATUS(RED_LED_NODE, okay) || \
	!DT_NODE_HAS_STATUS(GREEN_LED_NODE, okay) || \
	!DT_NODE_HAS_STATUS(BLUE_LED_NODE, okay)
#error "This board requires pwm_led0, pwm_led1 and pwm_led2 aliases"
#endif

static const struct pwm_dt_spec red_led =
	PWM_DT_SPEC_GET(RED_LED_NODE);
static const struct pwm_dt_spec green_led =
	PWM_DT_SPEC_GET(GREEN_LED_NODE);
static const struct pwm_dt_spec blue_led =
	PWM_DT_SPEC_GET(BLUE_LED_NODE);

static uint32_t brightness_to_pulse(const struct pwm_dt_spec *led,
					    uint8_t brightness)
{
	return (uint32_t)(((uint64_t)led->period * brightness) / UINT8_MAX);
}

static int set_color(uint8_t red, uint8_t green, uint8_t blue)
{
	int ret;

	ret = pwm_set_pulse_dt(&red_led, brightness_to_pulse(&red_led, red));
	if (ret != 0) {
		return ret;
	}

	ret = pwm_set_pulse_dt(&green_led,
				       brightness_to_pulse(&green_led, green));
	if (ret != 0) {
		return ret;
	}

	return pwm_set_pulse_dt(&blue_led,
				       brightness_to_pulse(&blue_led, blue));
}

void led_fader_run(void)
{
	if (!pwm_is_ready_dt(&red_led) ||
	    !pwm_is_ready_dt(&green_led) ||
	    !pwm_is_ready_dt(&blue_led)) {
		return;
	}

	while (1) {
		/* Fade continuously through green -> blue -> red -> green. */
		for (uint16_t step = 0; step <= UINT8_MAX; step++) {
			(void)set_color(0, UINT8_MAX - step, step);
			k_sleep(K_MSEC(10));
		}

		for (uint16_t step = 0; step <= UINT8_MAX; step++) {
			(void)set_color(step, 0, UINT8_MAX - step);
			k_sleep(K_MSEC(10));
		}

		for (uint16_t step = 0; step <= UINT8_MAX; step++) {
			(void)set_color(UINT8_MAX - step, step, 0);
			k_sleep(K_MSEC(10));
		}
	}
}
```
