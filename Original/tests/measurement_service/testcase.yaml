## Original/tests/measurement_service/testcase.yaml
```yaml
tests:
  aitsm.measurement_service:
    platform_allow:
      - native_sim/native/64
    integration_platforms:
      - native_sim/native/64
    timeout: 120
  aitsm.measurement_service.single:
    platform_allow:
      - native_sim/native/64
    extra_configs:
      - CONFIG_AITSM_TRANSMISSION_SINGLE=y
    timeout: 120
```

## Original/tests/mqtt_client/testcase.yaml
```yaml
tests:
  aitsm.mqtt_client:
    platform_allow:
      - native_sim/native/64
    integration_platforms:
      - native_sim/native/64
```

## Original/tests/nb_iot_config/testcase.yaml
```yaml
tests:
  aitsm.nb_iot_config:
    build_only: true
    platform_allow:
      - thingy91x/nrf9151/ns
    integration_platforms:
      - thingy91x/nrf9151/ns
```

## tests/data_transmission/testcase.yaml
```yaml
tests:
  aitsm.data_transmission:
    platform_allow:
      - native_sim
    integration_platforms:
      - native_sim
  aitsm.data_transmission.single:
    platform_allow:
      - native_sim
    integration_platforms:
      - native_sim
    extra_configs:
      - CONFIG_AITSM_TRANSMISSION_SINGLE=y
```

## tests/mqtt_reconnect/testcase.yaml
```yaml
tests:
  aitsm.mqtt_reconnect:
    platform_allow:
      - native_sim/native/64
    integration_platforms:
      - native_sim/native/64
  aitsm.mqtt_reconnect.custom:
    platform_allow:
      - native_sim/native/64
    extra_configs:
      - CONFIG_AITSM_MQTT_RECONNECT_INITIAL_DELAY_SECONDS=3
      - CONFIG_AITSM_MQTT_RECONNECT_MAX_DELAY_SECONDS=19
```
